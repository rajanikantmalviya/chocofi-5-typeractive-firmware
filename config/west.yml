## config/west.yml
```yaml
manifest:
  remotes:
    - name: cormoran
      url-base: https://github.com/cormoran
    - name: zmkfirmware
      url-base: https://github.com/zmkfirmware
  projects:
    - name: zmk
      remote: cormoran
      revision: 1fc72aaff7a42bd533c1f4c9b3f23c5317c745f4
      import: app/west.yml
    - name: zephyr
      remote: zmkfirmware
      revision: 10ba6d0cb38bc3d258775d27982f707599320085
      clone-depth: 1
      import:
        name-blocklist:
          - ci-tools
          - hal_altera
          - hal_cypress
          - hal_infineon
          - hal_microchip
          - hal_nxp
          - hal_openisa
          - hal_xtensa
          - hal_st
          - hal_ti
          - loramac-node
          - mcuboot
          - mcumgr
          - net-tools
          - openthread
          - edtt
          - trusted-firmware-m
    - name: zmk-feature-runtime-combo
      remote: cormoran
      revision: d9490e7b5d41c516221d131241009e81740efcee
    - name: zmk-feature-runtime-macro
      remote: cormoran
      revision: 38530962eb7061b60efcb98e84585cfb1f0cb6de
    - name: zmk-feature-custom-settings
      remote: cormoran
      revision: c6a7fef3a3be3d3ace5de9a4b0628c6418cd1f3f
  self:
    path: config
```

## dts/bindings/behaviors/zmk,behavior-mouse-speed.yaml
```yaml
description: Select a runtime percentage of keyboard mouse movement speed

compatible: "zmk,behavior-mouse-speed"

include: one_param.yaml
```

## dts/bindings/input_processors/zmk,input-processor-mouse-speed.yaml
```yaml
description: Scale keyboard cursor movement by the selected runtime percentage

compatible: "zmk,input-processor-mouse-speed"

include: ip_zero_param.yaml
```

## viewer/Kconfig
```kconfig
config ZMK_KEYBOARD_VIEWER
    bool "Read-only USB keyboard viewer"
    depends on ZMK_STUDIO && USB_CDC_ACM && UART_INTERRUPT_DRIVEN && UART_LINE_CTRL
    depends on !ZMK_SPLIT || ZMK_SPLIT_ROLE_CENTRAL
    help
      Provide layout, live bindings, combos, physical positions and active layers
      on a separate USB CDC interface. No data is sent without host requests.
      This never changes bindings or consumes keyboard events.

config ZMK_KEYBOARD_VIEWER_BLE
    bool "Read-only encrypted Bluetooth keyboard viewer"
    depends on ZMK_KEYBOARD_VIEWER && ZMK_BLE
    default y

config ZMK_RUNTIME_FACTORY
    bool "Bounded runtime factory migration and safety"
    depends on !ZMK_SPLIT || ZMK_SPLIT_ROLE_CENTRAL
    default y
    select ZMK_RUNTIME_COMBO
    select ZMK_RUNTIME_MACRO
    select ZMK_RUNTIME_COMBO_STUDIO_RPC if ZMK_STUDIO
    select ZMK_RUNTIME_MACRO_STUDIO_RPC if ZMK_STUDIO

if ZMK_RUNTIME_FACTORY
configdefault ZMK_RUNTIME_COMBO_MAX_COMBOS
    default 16
configdefault ZMK_RUNTIME_COMBO_MAX_POSITIONS_PER_COMBO
    default 4
configdefault ZMK_RUNTIME_MACRO_COUNT
    default 8
configdefault ZMK_RUNTIME_MACRO_POOL_BYTES
    default 1536
configdefault ZMK_CUSTOM_SETTINGS_LARGE_VALUE_MAX_SIZE
    default 256
configdefault ZMK_BEHAVIORS_QUEUE_SIZE
    default 160
endif

config ZMK_MOUSE_SPEED
    bool "Studio-adjustable mouse speed"
    default y
    depends on ZMK_POINTING && DT_HAS_ZMK_BEHAVIOR_MOUSE_SPEED_ENABLED
    help
      Add a Mouse Speed (%) behavior that selects a runtime percentage of
      keyboard cursor movement without changing acceleration or scrolling.
```
